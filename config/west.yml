## config/west.yml
```yaml
manifest:
  remotes:
    # zmk official
    - name: zmkfirmware
      url-base: https://github.com/zmkfirmware
      # Urchin keeb
    - name: duckyb
      url-base: https://github.com/duckyb
      # Forager keeb
    - name: carrefinho
      url-base: https://github.com/carrefinho
      # Extra module for battery indicator
    - name: caksoylar
      url-base: https://github.com/caksoylar
      # Dongle screen module
    - name: janpfischer
      url-base: https://github.com/janpfischer
  projects:
    - name: zmk
      remote: zmkfirmware
      revision: main
      import: app/west.yml
    - name: urchin-zmk-module
      remote: duckyb
      revision: main
    - name: forager-zmk-module
      remote: carrefinho
      revision: main
    - name: zmk-dongle-screen
      remote: janpfischer
      revision: upgrade-4.1
    - name: zmk-rgbled-widget
      remote: caksoylar
      revision: main
  self:
    path: config
```
