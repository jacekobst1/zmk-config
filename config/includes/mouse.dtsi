#define ZMK_POINTING_DEFAULT_MOVE_VAL 1200  // default: 600
#define ZMK_POINTING_DEFAULT_SCRL_VAL 15    // default: 10
#include <dt-bindings/zmk/pointing.h>
#include <input/processors.dtsi>

&mmv {
    time-to-max-speed-ms = <600>;
};